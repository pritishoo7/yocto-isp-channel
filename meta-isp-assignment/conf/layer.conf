## meta-isp-assignment/conf/layer.conf
```bitbake
BBPATH .= ":${LAYERDIR}"
BBFILES += "${LAYERDIR}/recipes-*/*/*.bb ${LAYERDIR}/recipes-*/*/*.bbappend"

BBFILE_COLLECTIONS += "meta-isp-assignment"
BBFILE_PATTERN_meta-isp-assignment = "^${LAYERDIR}/"
BBFILE_PRIORITY_meta-isp-assignment = "10"

LAYERDEPENDS_meta-isp-assignment = "core openembedded-layer multimedia-layer"
LAYERSERIES_COMPAT_meta-isp-assignment = "scarthgap"
```
